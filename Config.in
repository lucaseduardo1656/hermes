## Config.in
```kconfig
config BR2_EXTERNAL_HERMES_PATH
	string

source "$BR2_EXTERNAL_HERMES_PATH/package/elise/Config.in"
source "$BR2_EXTERNAL_HERMES_PATH/package/hermes-music/Config.in"
source "$BR2_EXTERNAL_HERMES_PATH/package/hermes-ipc/Config.in"
source "$BR2_EXTERNAL_HERMES_PATH/package/hermes-systemd/Config.in"
source "$BR2_EXTERNAL_HERMES_PATH/package/python-spotipy/Config.in"
source "$BR2_EXTERNAL_HERMES_PATH/package/python-yt-dlp/Config.in"
source "$BR2_EXTERNAL_HERMES_PATH/package/python-ytmusicapi/Config.in"
```

## configs/hermes_pi5_defconfig
```kconfig
BR2_aarch64=y
BR2_cortex_a76=y
BR2_ARM_FPU_VFPV4=y
BR2_KERNEL_HEADERS_6_6=y
BR2_TOOLCHAIN_BUILDROOT_CXX=y
BR2_GLOBAL_PATCH_DIR="$(BR2_EXTERNAL_HERMES_PATH)/board/hermes-pi5/patches"
BR2_TARGET_GENERIC_HOSTNAME="hermes"
BR2_TARGET_GENERIC_ISSUE="Hermes Car System"
BR2_INIT_SYSTEMD=y
BR2_TARGET_GENERIC_GETTY_PORT="ttyAMA0"
BR2_TARGET_GENERIC_GETTY_BAUDRATE_115200=y
BR2_ROOTFS_OVERLAY="$(BR2_EXTERNAL_HERMES_PATH)/board/hermes-pi5/rootfs-overlay"
BR2_ROOTFS_POST_BUILD_SCRIPT="$(BR2_EXTERNAL_HERMES_PATH)/board/hermes-pi5/post-build.sh"
BR2_ROOTFS_POST_FAKEROOT_SCRIPT="$(BR2_EXTERNAL_HERMES_PATH)/board/hermes-pi5/post-fakeroot.sh"
BR2_ROOTFS_POST_IMAGE_SCRIPT="$(BR2_EXTERNAL_HERMES_PATH)/board/hermes-pi5/post-image.sh"
BR2_ROOTFS_POST_SCRIPT_ARGS="$(BR2_EXTERNAL_HERMES_PATH)/board/hermes-pi5/genimage.cfg"
BR2_LINUX_KERNEL=y
BR2_LINUX_KERNEL_CUSTOM_TARBALL=y
BR2_LINUX_KERNEL_CUSTOM_TARBALL_LOCATION="$(call github,raspberrypi,linux,21b410140c47ffab5668399f6f143c7d7b935c8b)/linux-21b410140c47ffab5668399f6f143c7d7b935c8b.tar.gz"
BR2_LINUX_KERNEL_DEFCONFIG="bcm2712"
BR2_LINUX_KERNEL_CONFIG_FRAGMENT_FILES="$(BR2_EXTERNAL_HERMES_PATH)/board/hermes-pi5/linux-gpu.fragment"
BR2_LINUX_KERNEL_DTS_SUPPORT=y
BR2_LINUX_KERNEL_INTREE_DTS_NAME="broadcom/bcm2712-rpi-5-b broadcom/bcm2712d0-rpi-5-b"
BR2_LINUX_KERNEL_NEEDS_HOST_OPENSSL=y
BR2_LINUX_KERNEL_NEEDS_HOST_LIBELF=y
BR2_PACKAGE_ALSA_UTILS=y
BR2_PACKAGE_ALSA_UTILS_AMIXER=y
BR2_PACKAGE_GST1_PLUGINS_BASE_PLUGIN_ALSA=y
BR2_PACKAGE_GST1_PLUGINS_GOOD=y
BR2_PACKAGE_GST1_PLUGINS_GOOD_PLUGIN_AUTODETECT=y
BR2_PACKAGE_GST1_PLUGINS_GOOD_PLUGIN_AUDIOFX=y
BR2_PACKAGE_GST1_PLUGINS_GOOD_PLUGIN_AUDIOPARSERS=y
BR2_PACKAGE_GST1_PLUGINS_GOOD_PLUGIN_SOUPHTTPSRC=y
BR2_PACKAGE_GST1_PLUGINS_GOOD_PLUGIN_ISOMP4=y
BR2_PACKAGE_GLIB_NETWORKING=y
BR2_PACKAGE_GST1_LIBAV=y
BR2_PACKAGE_MPV=y
BR2_PACKAGE_GST1_PLUGINS_GOOD_PLUGIN_ID3DEMUX=y
BR2_PACKAGE_GST1_PLUGINS_GOOD_PLUGIN_MPG123=y
BR2_PACKAGE_GST1_PLUGINS_GOOD_PLUGIN_FLAC=y
BR2_PACKAGE_GST1_PLUGINS_BAD=y
BR2_PACKAGE_GST1_PLUGINS_BAD_PLUGIN_DASH=y
BR2_PACKAGE_GST1_PLUGINS_BAD_PLUGIN_HLS=y
BR2_PACKAGE_GST1_PLUGINS_UGLY=y
BR2_PACKAGE_PIPEWIRE=y
BR2_PACKAGE_XZ=y
BR2_PACKAGE_LIBERATION=y
BR2_PACKAGE_CAGE=y
BR2_PACKAGE_MESA3D=y
BR2_PACKAGE_MESA3D_GALLIUM_DRIVER_V3D=y
BR2_PACKAGE_MESA3D_OPENGL_ES=y
BR2_PACKAGE_QT6=y
BR2_PACKAGE_QT6BASE_CONCURRENT=y
BR2_PACKAGE_QT6BASE_EGLFS=y
BR2_PACKAGE_QT6BASE_FONTCONFIG=y
BR2_PACKAGE_QT6BASE_PNG=y
BR2_PACKAGE_QT6BASE_JPEG=y
BR2_PACKAGE_QT6DECLARATIVE=y
BR2_PACKAGE_QT6DECLARATIVE_QUICK=y
BR2_PACKAGE_QT6MULTIMEDIA=y
BR2_PACKAGE_QT6MULTIMEDIA_GSTREAMER=y
BR2_PACKAGE_QT6SVG=y
BR2_PACKAGE_QT6WAYLAND=y
BR2_PACKAGE_XKEYBOARD_CONFIG=y
BR2_PACKAGE_LINUX_FIRMWARE=y
BR2_PACKAGE_LINUX_FIRMWARE_BRCM_BCM43XX=y
BR2_PACKAGE_LINUX_FIRMWARE_BRCM_BCM43XXX=y
BR2_PACKAGE_RPI_FIRMWARE=y
BR2_PACKAGE_PYTHON3=y
BR2_PACKAGE_PYTHON3_SQLITE=y
BR2_PACKAGE_PYTHON_AIOFILES=y
BR2_PACKAGE_PYTHON_DOTENV=y
BR2_PACKAGE_PYTHON_FASTAPI=y
BR2_PACKAGE_PYTHON_HTTPX=y
BR2_PACKAGE_PYTHON_PYDANTIC=y
BR2_PACKAGE_PYTHON_PYDANTIC_SETTINGS=y
BR2_PACKAGE_PYTHON_REQUESTS=y
BR2_PACKAGE_PYTHON_STARLETTE=y
BR2_PACKAGE_PYTHON_UVICORN=y
BR2_PACKAGE_PYTHON_YT_DLP=y
BR2_PACKAGE_PYTHON_YTMUSICAPI=y
BR2_PACKAGE_PYTHON_SPOTIPY=y
BR2_PACKAGE_PYTHON_DISKCACHE=y
BR2_PACKAGE_CA_CERTIFICATES=y
BR2_PACKAGE_WAYLAND_UTILS=y
BR2_PACKAGE_LIBCURL=y
BR2_PACKAGE_BLUEZ5_UTILS=y
BR2_PACKAGE_BLUEZ5_UTILS_CLIENT=y
BR2_PACKAGE_BLUEZ5_UTILS_TOOLS=y
BR2_PACKAGE_LUA=y
BR2_PACKAGE_LUA_5_4=y
BR2_PACKAGE_WIREPLUMBER=y
BR2_PACKAGE_SBC=y
BR2_PACKAGE_LIBGLIB2=y
BR2_PACKAGE_DHCPCD=y
BR2_PACKAGE_DROPBEAR=y
BR2_PACKAGE_GPSD=y
BR2_PACKAGE_QT6POSITIONING=y
BR2_PACKAGE_QT6LOCATION=y
BR2_PACKAGE_WPA_SUPPLICANT=y
BR2_PACKAGE_WPA_SUPPLICANT_CLI=y
BR2_PACKAGE_WPA_SUPPLICANT_DBUS=y
BR2_PACKAGE_BASH=y
BR2_PACKAGE_SEATD_BUILTIN=y
BR2_PACKAGE_SYSTEMD_LOGIND=y
BR2_TARGET_ROOTFS_EXT2=y
BR2_TARGET_ROOTFS_EXT2_4=y
BR2_TARGET_ROOTFS_EXT2_SIZE="2G"
BR2_PACKAGE_HOST_DOSFSTOOLS=y
BR2_PACKAGE_HOST_GENIMAGE=y
BR2_PACKAGE_HOST_KMOD_XZ=y
BR2_PACKAGE_HOST_MTOOLS=y
BR2_PACKAGE_SDBUS_CPP=y
BR2_PACKAGE_HERMES_IPC=y
BR2_PACKAGE_HERMES_SYSTEMD=y
BR2_PACKAGE_HERMES_MUSIC=y
BR2_PACKAGE_ELISE=y
```

## package/elise/Config.in
```kconfig
config BR2_PACKAGE_ELISE
	bool "elise"
	depends on BR2_PACKAGE_QT6
	depends on BR2_PACKAGE_QT6DECLARATIVE
	help
	  Elise car system application (Qt6/QML).
```

## package/hermes-app/Config.in
```kconfig
config BR2_PACKAGE_HERMES_APP
	bool "hermes-app"
	depends on BR2_PACKAGE_QT6
	depends on BR2_PACKAGE_QT6DECLARATIVE
	help
	  Hermes car system application (Qt6/QML).
```

## package/hermes-ipc/Config.in
```kconfig
config BR2_PACKAGE_HERMES_IPC
	bool "hermes-ipc"
	help
	  Shared D-Bus interface definitions for the Hermes automotive
	  stack. Installs interface XML files and a CMake module
	  (HermesIpc) used by daemons and clients to generate sdbus-c++
	  proxy/adaptor stubs at build time.

	  https://github.com/lucaseduardo1656/hermes-ipc
```

## package/hermes-music/Config.in
```kconfig
config BR2_PACKAGE_HERMES_MUSIC
	bool "hermes-music"
	depends on BR2_PACKAGE_PYTHON3
	help
	  Music backend daemon for Hermes car multimedia.
	  Aggregates Spotify, YouTube Music and SoundCloud.
	  Serves stream URLs to the Qt frontend via HTTP.
```

## package/hermes-systemd/Config.in
```kconfig
config BR2_PACKAGE_HERMES_SYSTEMD
	bool "hermes-systemd"
	depends on BR2_INSTALL_LIBSTDCPP
	depends on BR2_PACKAGE_SYSTEMD
	depends on BR2_TOOLCHAIN_GCC_AT_LEAST_8 # C++20
	select BR2_PACKAGE_SDBUS_CPP
	select BR2_PACKAGE_HERMES_IPC
	help
	  Hermes system-level daemon. Owns org.hermes.System1 on the
	  D-Bus system bus and exposes hostname, uptime, OS version,
	  storage usage, plus privileged actions (reboot, power-off,
	  set-hostname).

	  https://github.com/lucaseduardo1656/hermes-systemd

comment "hermes-systemd needs systemd and a toolchain w/ C++20"
	depends on !BR2_INSTALL_LIBSTDCPP || !BR2_PACKAGE_SYSTEMD || \
		!BR2_TOOLCHAIN_GCC_AT_LEAST_8
```

## package/python-spotipy/Config.in
```kconfig
config BR2_PACKAGE_PYTHON_SPOTIPY
	bool "python-spotipy"
	select BR2_PACKAGE_PYTHON_REDIS
	select BR2_PACKAGE_PYTHON_REQUESTS
	help
	  Lightweight Python client for the Spotify Web API. Used by
	  hermes-music when a Spotify account is connected.

	  https://github.com/spotipy-dev/spotipy
```

## package/python-yt-dlp/Config.in
```kconfig
config BR2_PACKAGE_PYTHON_YT_DLP
	bool "python-yt-dlp"
	help
	  Command-line audio/video downloader with support for hundreds
	  of media sites. Used by hermes-music to resolve direct media
	  URLs for YouTube Music and SoundCloud.

	  https://github.com/yt-dlp/yt-dlp
```

## package/python-ytmusicapi/Config.in
```kconfig
config BR2_PACKAGE_PYTHON_YTMUSICAPI
	bool "python-ytmusicapi"
	select BR2_PACKAGE_PYTHON_REQUESTS
	help
	  Unofficial YouTube Music API for Python. Used by hermes-music
	  for search, charts, and home-feed sections.

	  https://github.com/sigma67/ytmusicapi
```
